## conf/bblayers.conf.sample
```bitbake
# LAYER_CONF_VERSION is increased each time build/conf/bblayers.conf
# changes incompatibly
LCONF_VERSION = "7"

BB_NUMBER_THREADS="6"
PARALLEL_MAKE="-j6"

BBPATH = "${TOPDIR}"
YOCTOROOT := "${@os.path.abspath(os.path.dirname(d.getVar('FILE', True)) + '/../..')}"

BBFILES ?= ""

BBLAYERS = " \
  ##OEROOT##/meta \
  ##OEROOT##/meta-poky \
  ##OEROOT##/meta-arm/meta-arm \
  ##OEROOT##/meta-arm/meta-arm-bsp \
  ##OEROOT##/meta-arm/meta-arm-toolchain \
  ##OEROOT##/meta-morello \
  "
```

## conf/layer.conf
```bitbake
BBPATH := "${BBPATH}:${LAYERDIR}"

BBFILES := "${BBFILES} \
            ${LAYERDIR}/images/*.bb \
            ${LAYERDIR}/recipes-*/*/*.bb \
	        ${LAYERDIR}/recipes-*/*/*.bbappend"

BBFILE_COLLECTIONS          += "meta-morello"
BBFILE_PATTERN_meta-morello := "^${LAYERDIR}/"
BBFILE_PRIORITY_meta-morello = "5"

LAYERDEPENDS_meta-morello = " \
    core \
    meta-arm \
"
LAYERSERIES_COMPAT_meta-morello = "kirkstone"
```

## conf/machine/include/morello-common.inc
```bitbake
require ${COREBASE}/meta/conf/machine/include/arm/armv8-2a/tune-neoversen1.inc
require conf/machine/include/morello-1.5.inc

MACHINEOVERRIDES =. "morello"

LLVM_SHARED_SOURCE ?= "${TMPDIR}/work-shared/${MACHINE}/llvm-morello-source"

MUSL_INSTALL_DIR ??=""

C64_ARCH_TRIPLE = "aarch64-linux-musl_purecap"
A64_ARCH_TRIPLE = "aarch64-linux-gnu"

A64_LIB_TRIPLE = "aarch64-unknown-linux-gnu"
C64_LIB_TRIPLE = "aarch64-unknown-linux-musl_purecap"

A64_ARCH_FLAGS = "-march=armv8"
C64_ARCH_FLAGS = "-march=morello+c64 -mabi=purecap"

MORELLO_ARCH       ?= "c64"
GLOBAL_ARCH_TRIPLE ?= "${C64_ARCH_TRIPLE}"
GLOBAL_LIB_TRIPLE  ?= "${C64_LIB_TRIPLE}"
GLOBAL_ARCH_FLAGS  ?= "${C64_ARCH_FLAGS}"

TMPDIR_BSP   = "tmp-bsp"
TMPDIR_LINUX = "tmp-linux"

APP_DIR ?= "pure-cap-apps"
```

## conf/machine/include/morello.inc
```bitbake
require ${COREBASE}/meta/conf/machine/include/arm/armv8-2a/tune-neoversen1.inc

MACHINEOVERRIDES =. "morello:"

PREFERRED_VERSION_scp-firmware       ?= "2.10%"
PREFERRED_VERSION_trusted-firmware-a ?= "2.7%"
PREFERRED_VERSION_board-firmware     ?= "1.4"

PREFERRED_PROVIDER_virtual/kernel    ?= "linux-morello-1.5"
```

## conf/machine/morello-linux-glibc.conf
```bitbake
require conf/machine/include/morello-common.inc

MACHINEOVERRIDES =. "morello-linux-glibc:"
```

## conf/machine/morello-linux-musl.conf
```bitbake
require conf/machine/include/morello-common.inc

MACHINEOVERRIDES =. "morello-linux-musl:"
```

## conf/machine/morello-linux.conf
```bitbake
require conf/machine/include/morello-common.inc

TARGET_OS ?= "linux-musl"

PREFERRED_PROVIDER_virtual/kernel     ?= "linux-morello-${MORELLO_RELEASE_VERSION}"
PREFERRED_PROVIDER_virtual/kernel     ?= "linux-morello-${MORELLO_RELEASE_VERSION}"

TCLIBC = "musl"

BSP_GRUB_DIR ?= "${TOPDIR}/${TMPDIR_BSP}-glibc/deploy/images/morello-bsp/grub-efi"
BSP_DTB_DIR  ?= "${TOPDIR}/${TMPDIR_BSP}-glibc/deploy/images/morello-bsp/trusted-firmware-a"

TMPDIR = "${TOPDIR}/${TMPDIR_LINUX}"
```
